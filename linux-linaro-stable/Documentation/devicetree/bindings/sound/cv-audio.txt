## ramdisk/configs/bm1880/multi.its
```
/*
 * U-Boot uImage source file with multiple kernels, ramdisks and FDT blobs
 */

/dts-v1/;

/ {
	description = "Various kernels, ramdisks and FDT blobs";
	#address-cells = <2>;

	images {
		kernel@1 {
			description = "bitmain kernel";
			data = /incbin/("./Image.gz");
			type = "kernel";
			arch = "arm64";
			os = "linux";
			compression = "gzip";
			load = <0x1 0x00080000>;
			entry = <0x1 0x00080000>;
			hash@2 {
				algo = "sha1";
			};
		};

		ramdisk@1 {
			description = "bitmain ramdisk";
			data = /incbin/("./rootfs.cpio.gz");
			type = "ramdisk";
			arch = "arm64";
			os = "linux";
			compression = "gzip";
			load = <00000000>;
			entry = <00000000>;
			hash@1 {
				algo = "sha1";
			};
		};

		fdt@1 {
			description = "bitmain device tree";
			data = /incbin/("./bitmain.dtb");
			type = "flat_dt";
			arch = "arm64";
			compression = "none";
			hash@1 {
				algo = "sha1";
			};
		};
	};

	configurations {
		default = "config@1";

		config@1 {
			description = "boot a minimal system from RAM";
			kernel = "kernel@1";
			ramdisk = "ramdisk@1";
			fdt = "fdt@1";
			signature@1 {
				algo = "sha1,rsa2048";
				key-name-hint = "vboot";
				sign-images = "fdt", "ramdisk", "kernel";
			};
		};
	};
};
```

## u-boot/board/bitmain/bm1880/Kconfig
```kconfig
if TARGET_BITMAIN_BM1880

choice
	prompt "Bitmain BM1880 verification platform type select"

config TARGET_BITMAIN_BM1880_ASIC
	bool "ASIC"

config TARGET_BITMAIN_BM1880_ASIC_MINER
	bool "ASIC"

config TARGET_BITMAIN_BM1880_PALLADIUM
	bool "Palladium"

config TARGET_BITMAIN_BM1880_FPGA
	bool "FPGA"

config TARGET_BITMAIN_BM1880_FPGA_MINER
	bool "FPGA"

config TARGET_BITMAIN_BM1880_QEMU
	bool "QEMU"

endchoice

config SYS_BOARD
	default "bm1880"

config SYS_VENDOR
	default "bitmain"

config SYS_CONFIG_NAME
	default "bm1880-asic" if TARGET_BITMAIN_BM1880_ASIC
	default "bm1880-asic-miner" if TARGET_BITMAIN_BM1880_ASIC_MINER
	default "bm1880-palladium" if TARGET_BITMAIN_BM1880_PALLADIUM
	default "bm1880-fpga" if TARGET_BITMAIN_BM1880_FPGA
	default "bm1880-fpga-miner" if TARGET_BITMAIN_BM1880_FPGA_MINER
	default "bm1880-qemu" if TARGET_BITMAIN_BM1880_QEMU

endif
```

## u-boot/board/bitmain/bm1882/Kconfig
```kconfig
if TARGET_BITMAIN_BM1882

choice
	prompt "Bitman BM1882 verification platform type select"

config TARGET_BITMAIN_BM1882_ASIC
	bool "ASIC"
	help
	  This enables support for Bitmain's BM1882 SoC on ASIC platform.

	  If unsure, say N.

config TARGET_BITMAIN_BM1882_PALLADIUM
	bool "Palladium"
	help
	  This enables support for Bitmain's BM1882 SoC on PALLADIUM platform.

	  If unsure, say N.

config TARGET_BITMAIN_BM1882_FPGA
	bool "FPGA"
	help
	  This enables support for Bitmain's BM1882 SoC on FPGA platform.

	  If unsure, say N.

endchoice

config SYS_BOARD
	default "bm1882"

config SYS_VENDOR
	default "bitmain"

config SYS_CONFIG_NAME
	default "bm1882-asic" if TARGET_BITMAIN_BM1882_ASIC
	default "bm1882-palladium" if TARGET_BITMAIN_BM1882_PALLADIUM
	default "bm1882-fpga" if TARGET_BITMAIN_BM1882_FPGA

endif
```

## u-boot/configs/bitmain_bm1880_asic_nnm_defconfig
```kconfig
CONFIG_ARM=y
CONFIG_TARGET_BITMAIN=y
CONFIG_TARGET_BITMAIN_BM1880=y
CONFIG_TARGET_BITMAIN_BM1880_ASIC=y
CONFIG_SYS_MALLOC_F_LEN=0x2000
CONFIG_IDENT_STRING=" bitmain_bm1880"
CONFIG_DISTRO_DEFAULTS=y
CONFIG_BOOTDELAY=1
# CONFIG_DISPLAY_CPUINFO is not set
# CONFIG_DISPLAY_BOARDINFO is not set
CONFIG_SYS_PROMPT="bm1880# "
# CONFIG_CMD_CONSOLE is not set
# CONFIG_CMD_IMLS is not set
# CONFIG_CMD_XIMG is not set
# CONFIG_CMD_EDITENV is not set
# CONFIG_CMD_ENV_EXISTS is not set
CONFIG_CMD_MEMTEST=y
CONFIG_CMD_UNZIP=y
CONFIG_CMD_MMC=y
# CONFIG_CMD_LOADS is not set
# CONFIG_CMD_ARMFLASH is not set
# CONFIG_CMD_FPGA is not set
# CONFIG_CMD_ITEST is not set
# CONFIG_CMD_SETEXPR is not set
CONFIG_CMD_NFS=y
CONFIG_CMD_CACHE=y
CONFIG_CMD_FAT=y
CONFIG_CMD_BM_UPDATE=y
CONFIG_CMD_BM_MMCBCB=y
# CONFIG_CMD_MISC is not set
# CONFIG_ISO_PARTITION is not set
CONFIG_EFI_PARTITION=y
CONFIG_BLK=y
CONFIG_DM=y
CONFIG_DM_MMC=y
CONFIG_DM_GPIO=y
CONFIG_DM_RESET=y
CONFIG_RESET_BITMAIN=y
CONFIG_DWAPB_GPIO=y
CONFIG_CLK=y
CONFIG_MMC=y
CONFIG_MMC_SDHCI=y
CONFIG_MMC_SDHCI_SDMA=y
CONFIG_MMC_SDHCI_BITMAIN=y
# CONFIG_MTD_NOR_FLASH is not set
CONFIG_OF_LIBFDT=y
CONFIG_OF_CONTROL=y
CONFIG_OF_SEPARATE=y
CONFIG_DEFAULT_DEVICE_TREE="bm1880_asic"
CONFIG_SYS_NS16550=y
CONFIG_BAUDRATE=115200
CONFIG_ARMV8_SET_SMPEN=y
CONFIG_PHYLIB=y
# CONFIG_PHY_BROADCOM is not set
# CONFIG_PHY_SMSC is not set
# CONFIG_PHY_MARVELL is not set
# CONFIG_PHY_FIXED is not set
# CONFIG_DM_ETH is not set
# CONFIG_NETDEVICES is not set
# CONFIG_DWC_ETH_QOS is not set
# CONFIG_NET_RANDOM_ETHADDR is not set
CONFIG_FIT=y
CONFIG_CMD_BM_REBOOT=y
# CONFIG_ARCH_FIXUP_FDT_MEMORY is not set
CONFIG_CMD_BM_UTASK=y
```

## u-boot/test/bitmain/Kconfig
```kconfig
config UT_BM
	bool "Enable bitmain unit tests"
	depends on UNIT_TEST
	help
	  This enables the 'ut bm' command which runs a series of unit
	  tests on the bitmain code.
	  If all is well then all tests pass although there will be a few
	  messages printed along the way.
```

## u-boot/vboot/vboot.its
```
/*
 * Dummy package used for mkimage padding public keys to dtb
 */

/dts-v1/;

/ {
	description = "Dummy package used for mkimage padding public keys to dtb";
	images {
		blob {
			description = "Dummy blob to be signed";
			data = /incbin/("./vboot.bin");
			hash {
				algo = "sha1";
			};
		};
	};

	configurations {
		default = "config";

		config {
			description = "Dummy configurations";
			kernel = "blob";
			signature {
				algo = "sha1,rsa2048";
				key-name-hint = "vboot";
				sign-images = "kernel";
			};
		};
	};
};
```
