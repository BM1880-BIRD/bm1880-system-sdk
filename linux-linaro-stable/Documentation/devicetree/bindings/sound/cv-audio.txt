## linux-linaro-stable/arch/arm64/configs/bitmain_bm1880_asic_edb_defconfig
```kconfig
CONFIG_SYSVIPC=y
CONFIG_POSIX_MQUEUE=y
CONFIG_FHANDLE=y
CONFIG_NO_HZ_IDLE=y
CONFIG_HIGH_RES_TIMERS=y
CONFIG_TASKSTATS=y
CONFIG_SCHED_AUTOGROUP=y
CONFIG_PROFILING=y
CONFIG_MODULES=y
CONFIG_MODULE_UNLOAD=y
CONFIG_MODULE_FORCE_LOAD=y
CONFIG_MODULE_FORCE_UNLOAD=y
CONFIG_BLK_DEV_BSGLIB=y
CONFIG_ARCH_BITMAIN=y
CONFIG_ARCH_BM1880=y
CONFIG_ARCH_BM1880_ASIC=y
CONFIG_BM1880_PRODUCT_EDB=y
CONFIG_SMP=y
CONFIG_TRANSPARENT_HUGEPAGE=y
CONFIG_COMPAT=y
CONFIG_NET=y
CONFIG_COMPAT_NETLINK_MESSAGES=y
CONFIG_WEXT_CORE=y
CONFIG_WEXT_PROC=y
CONFIG_WLAN=y
CONFIG_CFG80211=y
CONFIG_WLAN_VENDOR_REALTEK=y
CONFIG_RTL8821CU=y
CONFIG_CFG80211_DEFAULT_PS=y
CONFIG_CFG80211_CRDA_SUPPORT=y
CONFIG_CFG80211_WEXT=y
CONFIG_MAC80211=y
CONFIG_MAC80211_HAS_RC=y
CONFIG_MAC80211_RC_MINSTREL=y
CONFIG_MAC80211_RC_MINSTREL_HT=y
CONFIG_MAC80211_RC_DEFAULT_MINSTREL=y
CONFIG_MAC80211_RC_DEFAULT="minstrel_ht"
CONFIG_PACKET=y
CONFIG_PACKET_DIAG=y
CONFIG_UNIX=y
CONFIG_INET=y
CONFIG_IP_MULTICAST=y
CONFIG_IP_PNP=y
CONFIG_NET_SCHED=y
CONFIG_DEVTMPFS=y
CONFIG_DEVTMPFS_MOUNT=y
CONFIG_BLK_DEV_SD=y
CONFIG_CHR_DEV_SG=y
CONFIG_NETDEVICES=y
CONFIG_ETHERNET=y
CONFIG_NET_VENDOR_STMICRO=y
CONFIG_STMMAC_ETH=y
CONFIG_STMMAC_PLATFORM=y
CONFIG_DWMAC_BITMAIN=y
# CONFIG_NET_VENDOR_BITMAIN is not set
CONFIG_BROADCOM_PHY=y
CONFIG_MARVELL_PHY=y
CONFIG_SMSC_PHY=y
# CONFIG_FIXED_PHY is not set
CONFIG_SERIAL_8250=y
CONFIG_SERIAL_8250_CONSOLE=y
CONFIG_SERIAL_8250_DW=y
CONFIG_HW_RANDOM=y
CONFIG_RTC_CLASS=y
CONFIG_EXT4_FS=y
CONFIG_TMPFS=y
CONFIG_NFS_FS=y
CONFIG_ROOT_NFS=y
CONFIG_DEBUG_KERNEL=y
CONFIG_DEBUG_INFO=y
CONFIG_PRINTK_TIME=y
CONFIG_BLK_DEV_INITRD=y
CONFIG_SQUASHFS=y
CONFIG_SQUASHFS_LZ4=y
CONFIG_SQUASHFS_LZO=y
CONFIG_SQUASHFS_XZ=y
CONFIG_SQUASHFS_ZLIB=y
CONFIG_BT=y
CONFIG_BT_HCIBTUSB=y
CONFIG_BT_HCIBTUSB_RTL=y
CONFIG_BT_BREDR=y
CONFIG_BT_HS=y
CONFIG_BT_LE=y
CONFIG_BT_SELFTEST=y
CONFIG_BT_RFCOMM=y
CONFIG_BT_RFCOMM_TTY=y
CONFIG_BT_BNEP=y
CONFIG_BT_HIDP=y
CONFIG_UHID=y
CONFIG_RFKILL=y
# CONFIG_BT_DEBUGFS is not set
CONFIG_INPUT_MISC=y
CONFIG_INPUT_UINPUT=y
#CONFIG_BT_HCIUART is not set
#CONFIG_BT_HCIUART_H4 is not set
#CONFIG_BT_HCIUART_RTKH5 is not set
CONFIG_BT_RTKCOEX=y
CONFIG_FB=y
CONFIG_FB_ARMCLCD=y
CONFIG_ENABLE_DEFAULT_TRACERS=y
CONFIG_GPIOLIB=y
CONFIG_GPIO_SYSFS=y
CONFIG_GPIO_DWAPB=y
CONFIG_MMC=y
CONFIG_MMC_BLOCK=y
CONFIG_MMC_BLOCK_MINORS=8
CONFIG_MMC_SDHCI=y
CONFIG_MMC_SDHCI_PLTFM=y
CONFIG_MMC_SDHCI_BM=y
CONFIG_CMA=y
CONFIG_DMA_CMA=y
CONFIG_USB=y
CONFIG_USB_BM_GADGET=y
CONFIG_USB_GADGET=y
CONFIG_U_SERIAL_CONSOLE=y
CONFIG_USB_CONFIGFS=y
CONFIG_USB_CONFIGFS_SERIAL=y
CONFIG_USB_CONFIGFS_ACM=y
CONFIG_USB_CONFIGFS_MASS_STORAGE=y
CONFIG_USB_CONFIGFS_F_LB_SS=y
CONFIG_USB_CONFIGFS_F_FS=y
# CONFIG_USB_G_SERIAL is not set
CONFIG_USB_CONFIGFS_BCM=y
# CONFIG_USB_G_ACM_MS is not set
# usb otg
CONFIG_USB_OTG=y
CONFIG_USB_OTG_FSM=y
CONFIG_USB_BM_DRD=y

# usb host storage
CONFIG_USB_XHCI_HCD=y
CONFIG_USB_XHCI_PLATFORM=y
CONFIG_SCSI=y
CONFIG_USB_STORAGE=y
#CONFIG_USB_STORAGE_DEBUG=y
CONFIG_USB_STORAGE_REALTEK=y
CONFIG_USB_STORAGE_DATAFAB=y
CONFIG_USB_STORAGE_FREECOM=y
CONFIG_USB_STORAGE_ISD200=y
CONFIG_USB_STORAGE_USBAT=y
CONFIG_USB_STORAGE_SDDR09=y
CONFIG_USB_STORAGE_SDDR55=y
CONFIG_USB_STORAGE_JUMPSHOT=y
CONFIG_USB_STORAGE_ALAUDA=y
CONFIG_USB_STORAGE_ONETOUCH=y
CONFIG_USB_STORAGE_KARMA=y
CONFIG_USB_STORAGE_CYPRESS_ATACB=y
CONFIG_USB_STORAGE_ENE_UB6250=y
CONFIG_USB_UAS=y
CONFIG_BLK_DEV_LOOP=y
# usb host storage end
CONFIG_STAGING=y
CONFIG_ANDROID=y
CONFIG_ION=y
CONFIG_ION_CARVEOUT_HEAP=y
CONFIG_EFIVAR_FS=n
CONFIG_CRYPTO_HW=n
CONFIG_CRYPTO_ECHAINIV=n
CONFIG_VPP_ENB=y
CONFIG_I2C=y
CONFIG_I2C_CHARDEV=y
CONFIG_I2C_DESIGNWARE_CORE=y
CONFIG_I2C_DESIGNWARE_PLATFORM=y
CONFIG_KEXEC=y
CONFIG_CRASH_DUMP=y
CONFIG_MAGIC_SYSRQ=y
CONFIG_FAT_FS=y
CONFIG_MSDOS_FS=y
CONFIG_VFAT_FS=y
CONFIG_FAT_DEFAULT_CODEPAGE=437
CONFIG_FAT_DEFAULT_IOCHARSET="iso8859-1"
CONFIG_NLS=y
CONFIG_NLS_DEFAULT="iso8859-1"
CONFIG_NLS_CODEPAGE_437=y
CONFIG_NLS_CODEPAGE_850=y
CONFIG_NLS_ISO8859_1=y
CONFIG_NLS_ISO8859_2=y
CONFIG_NLS_ISO8859_3=y
CONFIG_NLS_UTF8=y
#CONFIG_BITMAIN_NPU is not set
CONFIG_RESET_CONTROLLER=y
CONFIG_RESET_BITMAIN=y
CONFIG_PWM=y
CONFIG_PWM_BITMAIN=y
#uvc support
CONFIG_FRAME_VECTOR=y
CONFIG_I2C_MUX=y
CONFIG_MEDIA_SUPPORT=y
CONFIG_MEDIA_CAMERA_SUPPORT=y
CONFIG_VIDEO_DEV=y
CONFIG_VIDEO_V4L2=y
CONFIG_VIDEOBUF2_CORE=y
CONFIG_VIDEOBUF2_MEMOPS=y
CONFIG_VIDEOBUF2_VMALLOC=y
CONFIG_MEDIA_SUBDRV_AUTOSELECT=y
CONFIG_USB_F_UVC=y
CONFIG_USB_CONFIGFS_F_UVC=y
CONFIG_MEDIA_USB_SUPPORT=y
CONFIG_USB_VIDEO_CLASS=y
CONFIG_USB_VIDEO_CLASS_INPUT_EVDEV=y
CONFIG_USB_GSPCA=m
#uvc support end
#
# USB Device Class drivers
#
CONFIG_USB_ACM=y
CONFIG_USB_MUSB_HDRC=y
#
# SPI drivers
#
CONFIG_SPI=y
CONFIG_SPI_MASTER=y
CONFIG_SPI_DESIGNWARE=y
CONFIG_SPI_DW_MMIO=y
CONFIG_SPI_SPIDEV=m
#
# fbtft drivers
#
#CONFIG_FB_SYS_FILLRECT=m
#CONFIG_FB_SYS_COPYAREA=m
#CONFIG_FB_SYS_IMAGEBLIT=m
#CONFIG_FB_SYS_FOPS=m
#CONFIG_FB_TFT=m
#CONFIG_FB_TFT_ILI9341=m
#
# PM Suspend
#
CONFIG_PM_DEBUG=y
CONFIG_PM_TEST_SUSPEND=y
CONFIG_PM_ADVANCED_DEBUG=y
#
# WATCHDOG
#
CONFIG_WATCHDOG=y
CONFIG_DW_WATCHDOG=y
CONFIG_DYNAMIC_DEBUG=y
CONFIG_HW_PERF_EVENTS=y
CONFIG_RCU_CPU_STALL_TIMEOUT=21
CONFIG_NOP_TRACER=y
CONFIG_HAVE_FUNCTION_TRACER=y
CONFIG_HAVE_FUNCTION_GRAPH_TRACER=y
CONFIG_HAVE_DYNAMIC_FTRACE=y
CONFIG_HAVE_FTRACE_MCOUNT_RECORD=y
CONFIG_HAVE_SYSCALL_TRACEPOINTS=y
CONFIG_HAVE_C_RECORDMCOUNT=y
CONFIG_TRACER_MAX_TRACE=y
CONFIG_TRACE_CLOCK=y
CONFIG_RING_BUFFER=y
CONFIG_EVENT_TRACING=y
CONFIG_CONTEXT_SWITCH_TRACER=y
CONFIG_RING_BUFFER_ALLOW_SWAP=y
CONFIG_TRACING=y
CONFIG_GENERIC_TRACER=y
CONFIG_TRACING_SUPPORT=y
CONFIG_FTRACE=y
CONFIG_FUNCTION_TRACER=y
CONFIG_FUNCTION_GRAPH_TRACER=y
CONFIG_IRQSOFF_TRACER=y
CONFIG_SCHED_TRACER=y
CONFIG_HWLAT_TRACER=y
CONFIG_FTRACE_SYSCALLS=y
CONFIG_TRACER_SNAPSHOT=y
CONFIG_TRACER_SNAPSHOT_PER_CPU_SWAP=y
CONFIG_BRANCH_PROFILE_NONE=y
CONFIG_STACK_TRACER=y
CONFIG_BLK_DEV_IO_TRACE=y
CONFIG_DYNAMIC_FTRACE=y
CONFIG_FUNCTION_PROFILER=y
CONFIG_FTRACE_MCOUNT_RECORD=y
CONFIG_THERMAL=y
CONFIG_SENSORS_LM90=y
CONFIG_THERMAL_HWMON=y
CONFIG_COMMON_CLK_BITMAIN=y
CONFIG_COMMON_CLK=y
CONFIG_HAVE_CLK=y
CONFIG_BM1880_CLOCK_COOLING=y

CONFIG_DMI=n
```

## linux-linaro-stable/arch/arm64/configs/bitmain_bm1880_asic_nnm_defconfig
```kconfig
CONFIG_SYSVIPC=y
CONFIG_POSIX_MQUEUE=y
CONFIG_FHANDLE=y
CONFIG_NO_HZ_IDLE=y
CONFIG_HIGH_RES_TIMERS=y
CONFIG_TASKSTATS=y
CONFIG_SCHED_AUTOGROUP=y
CONFIG_PROFILING=y
CONFIG_MODULES=y
CONFIG_MODULE_UNLOAD=y
CONFIG_MODULE_FORCE_LOAD=y
CONFIG_MODULE_FORCE_UNLOAD=y
CONFIG_BLK_DEV_BSGLIB=y
CONFIG_ARCH_BITMAIN=y
CONFIG_ARCH_BM1880=y
CONFIG_ARCH_BM1880_ASIC=y
CONFIG_SMP=y
CONFIG_TRANSPARENT_HUGEPAGE=y
CONFIG_COMPAT=y
CONFIG_NET=y
CONFIG_PACKET=y
CONFIG_PACKET_DIAG=y
CONFIG_UNIX=y
CONFIG_INET=y
CONFIG_IP_MULTICAST=y
CONFIG_IP_PNP=y
CONFIG_NET_SCHED=y
CONFIG_DEVTMPFS=y
CONFIG_DEVTMPFS_MOUNT=y
CONFIG_BLK_DEV_SD=y
CONFIG_CHR_DEV_SG=y
CONFIG_NETDEVICES=y
CONFIG_ETHERNET=y
CONFIG_NET_VENDOR_STMICRO=y
CONFIG_STMMAC_ETH=y
CONFIG_STMMAC_PLATFORM=y
CONFIG_DWMAC_BITMAIN=y
# CONFIG_NET_VENDOR_BITMAIN is not set
CONFIG_BROADCOM_PHY=y
CONFIG_MARVELL_PHY=y
CONFIG_SMSC_PHY=y
# CONFIG_FIXED_PHY is not set
CONFIG_SERIAL_8250=y
CONFIG_SERIAL_8250_CONSOLE=y
CONFIG_SERIAL_8250_DW=y
CONFIG_HW_RANDOM=y
CONFIG_RTC_CLASS=y
CONFIG_EXT4_FS=y
CONFIG_TMPFS=y
CONFIG_NFS_FS=y
CONFIG_ROOT_NFS=y
CONFIG_DEBUG_KERNEL=y
CONFIG_DEBUG_INFO=y
CONFIG_PRINTK_TIME=y
CONFIG_BLK_DEV_INITRD=y
CONFIG_ENABLE_DEFAULT_TRACERS=y
CONFIG_BT=y
CONFIG_BT_BREDR=y
CONFIG_BT_HS=y
CONFIG_BT_LE=y
CONFIG_BT_SELFTEST=y
CONFIG_BT_RFCOMM=y
CONFIG_BT_HCIUART=y
CONFIG_BT_HCIUART_H4=y
CONFIG_BT_HCIUART_RTKH5=y
CONFIG_BT_RTKCOEX=y
CONFIG_GPIOLIB=y
CONFIG_GPIO_SYSFS=y
CONFIG_GPIO_DWAPB=y
CONFIG_MMC=y
CONFIG_MMC_BLOCK=y
CONFIG_MMC_BLOCK_MINORS=8
CONFIG_MMC_SDHCI=y
CONFIG_MMC_SDHCI_PLTFM=y
CONFIG_MMC_SDHCI_BM=y
CONFIG_CMA=y
CONFIG_DMA_CMA=y
CONFIG_USB=y
CONFIG_USB_BM_GADGET=y
CONFIG_USB_GADGET=y
CONFIG_U_SERIAL_CONSOLE=y
CONFIG_USB_CONFIGFS=y
CONFIG_USB_CONFIGFS_SERIAL=y
CONFIG_USB_CONFIGFS_ACM=y
CONFIG_USB_CONFIGFS_MASS_STORAGE=y
CONFIG_USB_CONFIGFS_F_LB_SS=y
CONFIG_USB_CONFIGFS_F_FS=y
# CONFIG_USB_G_SERIAL is not set
CONFIG_USB_CONFIGFS_BCM=y
# CONFIG_USB_G_ACM_MS is not set
# usb otg
CONFIG_USB_OTG=y
CONFIG_USB_OTG_FSM=y
CONFIG_USB_BM_DRD=y

# usb host storage
CONFIG_USB_XHCI_HCD=y
CONFIG_USB_XHCI_PLATFORM=y
CONFIG_SCSI=y
CONFIG_USB_STORAGE=y
#CONFIG_USB_STORAGE_DEBUG=y
CONFIG_USB_STORAGE_REALTEK=y
CONFIG_USB_STORAGE_DATAFAB=y
CONFIG_USB_STORAGE_FREECOM=y
CONFIG_USB_STORAGE_ISD200=y
CONFIG_USB_STORAGE_USBAT=y
CONFIG_USB_STORAGE_SDDR09=y
CONFIG_USB_STORAGE_SDDR55=y
CONFIG_USB_STORAGE_JUMPSHOT=y
CONFIG_USB_STORAGE_ALAUDA=y
CONFIG_USB_STORAGE_ONETOUCH=y
CONFIG_USB_STORAGE_KARMA=y
CONFIG_USB_STORAGE_CYPRESS_ATACB=y
CONFIG_USB_STORAGE_ENE_UB6250=y
CONFIG_USB_UAS=y
CONFIG_BLK_DEV_LOOP=y
# usb host storage end
CONFIG_STAGING=y
CONFIG_ANDROID=y
CONFIG_ION=y
CONFIG_ION_CARVEOUT_HEAP=y
CONFIG_EFIVAR_FS=n
CONFIG_CRYPTO_HW=n
CONFIG_CRYPTO_ECHAINIV=n
CONFIG_VPP_ENB=y
CONFIG_I2C=y
CONFIG_I2C_CHARDEV=y
CONFIG_I2C_DESIGNWARE_CORE=y
CONFIG_I2C_DESIGNWARE_PLATFORM=y
CONFIG_KEXEC=y
CONFIG_CRASH_DUMP=y
CONFIG_MAGIC_SYSRQ=y
CONFIG_FAT_FS=y
CONFIG_MSDOS_FS=y
CONFIG_VFAT_FS=y
CONFIG_FAT_DEFAULT_CODEPAGE=437
CONFIG_FAT_DEFAULT_IOCHARSET="iso8859-1"
CONFIG_NLS=y
CONFIG_NLS_DEFAULT="iso8859-1"
CONFIG_NLS_CODEPAGE_437=y
CONFIG_NLS_CODEPAGE_850=y
CONFIG_NLS_ISO8859_1=y
CONFIG_NLS_ISO8859_2=y
CONFIG_NLS_ISO8859_3=y
CONFIG_NLS_UTF8=y
#CONFIG_BITMAIN_NPU is not set
CONFIG_RESET_CONTROLLER=y
CONFIG_RESET_BITMAIN=y
CONFIG_PWM=y
CONFIG_PWM_BITMAIN=y
#
# PM Suspend
#
CONFIG_PM_DEBUG=y
CONFIG_PM_TEST_SUSPEND=y
CONFIG_PM_ADVANCED_DEBUG=y
#
# WATCHDOG
#
CONFIG_WATCHDOG=y
CONFIG_DW_WATCHDOG=y
CONFIG_DYNAMIC_DEBUG=y
CONFIG_HW_PERF_EVENTS=y
CONFIG_RCU_CPU_STALL_TIMEOUT=21
CONFIG_NOP_TRACER=y
CONFIG_HAVE_FUNCTION_TRACER=y
CONFIG_HAVE_FUNCTION_GRAPH_TRACER=y
CONFIG_HAVE_DYNAMIC_FTRACE=y
CONFIG_HAVE_FTRACE_MCOUNT_RECORD=y
CONFIG_HAVE_SYSCALL_TRACEPOINTS=y
CONFIG_HAVE_C_RECORDMCOUNT=y
CONFIG_TRACER_MAX_TRACE=y
CONFIG_TRACE_CLOCK=y
CONFIG_RING_BUFFER=y
CONFIG_EVENT_TRACING=y
CONFIG_CONTEXT_SWITCH_TRACER=y
CONFIG_RING_BUFFER_ALLOW_SWAP=y
CONFIG_TRACING=y
CONFIG_GENERIC_TRACER=y
CONFIG_TRACING_SUPPORT=y
CONFIG_FTRACE=y
CONFIG_FUNCTION_TRACER=y
CONFIG_FUNCTION_GRAPH_TRACER=y
CONFIG_IRQSOFF_TRACER=y
CONFIG_SCHED_TRACER=y
CONFIG_HWLAT_TRACER=y
CONFIG_FTRACE_SYSCALLS=y
CONFIG_TRACER_SNAPSHOT=y
CONFIG_TRACER_SNAPSHOT_PER_CPU_SWAP=y
CONFIG_BRANCH_PROFILE_NONE=y
CONFIG_STACK_TRACER=y
CONFIG_BLK_DEV_IO_TRACE=y
CONFIG_DYNAMIC_FTRACE=y
CONFIG_FUNCTION_PROFILER=y
CONFIG_FTRACE_MCOUNT_RECORD=y
CONFIG_THERMAL=y
CONFIG_SENSORS_LM90=y
CONFIG_THERMAL_HWMON=y
CONFIG_COMMON_CLK_BITMAIN=y
CONFIG_COMMON_CLK=y
CONFIG_HAVE_CLK=y
CONFIG_BM1880_CLOCK_COOLING=y

CONFIG_DMI=n
```

## linux-linaro-stable/drivers/clk/bitmain/Kconfig
```kconfig
config COMMON_CLK_BM1684
	bool "bm1684 Clock Tree Driver"
	depends on ARCH_BITMAIN
	depends on COMMON_CLK
	default n
	help
	  Build the clock driver for bitmain bm1684 SOC.
```

## linux-linaro-stable/drivers/net/ethernet/bitmain/Kconfig
```kconfig
#
# Bitmain network device configuration
#

config NET_VENDOR_BITMAIN
	bool "Bitmain devices"
	default y
	---help---
	  If you have a network (Ethernet) device belonging to this class, say Y.

	  Note that the answer to this question doesn't directly affect the
	  kernel: saying N will just cause the configurator to skip all
	  the questions about Synopsys devices. If you say Y, you will be asked
	  for your specific device in the following questions.

if NET_VENDOR_BITMAIN

config DWC_ETH_QOS
	tristate "Synopsys DWC Ethernet QOS v4.21a support"
	select PHYLIB
	select CRC32
	select MII
	select VLAN_8021Q
	depends on OF && HAS_DMA
	default ARCH_BITMAIN
	---help---
	  This driver supports the DWC Ethernet QoS from Synopsys

if DWC_ETH_QOS

config PGTEST_OBJ
	boolean "PGTEST support for DWC_ETH_QOS drivers"

config DEBUGFS_OBJ
	boolean "DEBUGFS support for DWC_ETH_QOS drivers"

config PTPSUPPORT_OBJ
	boolean "PTP support for DWC_ETH_QOS drivers"

config DWCEQOS_PCI
	tristate "PCI bus DWC_ETH_QOS support"
	depends on PCI && !DWCEQOS_BITMAIN
	---help---
	  This is to select the DWC_ETH_QOS available on PCI devices,
	  if you have a controller with this interface, say Y or M here.

	  If unsure, say N.

config DWCEQOS_BITMAIN
	tristate "Bitmain DWC_ETH_QOS support"
	default ARCH_BITMAIN
	---help---
	  Support for DWC_ETH_QOS controller on Bitmain SOCs.

	  This selects Bitmain SoC glue layer support for the DWC_ETH_QOS driver.
	  This driver is used on for the Bitmain series SOCs ethernet controller.

endif # DWC_ETH_QOS

endif # NET_VENDOR_BITMAIN
```

## linux-linaro-stable/drivers/pinctrl/bitmain/Kconfig
```kconfig
if ARCH_BITMAIN

config BITMAIN_PINCTRL_CORE
	bool
	select PINMUX
	select PINCONF
	select GENERIC_PINCONF
	help
	  This enables pin control core drivers for Bitmain platforms

config BITMAIN_PINCTRL_BM1684
	bool "This enable pinctrl for bm1684 platform"
	select BITMAIN_PINCTRL_CORE
	help
	  This enable pinctrl driver for bitmain bm1880 platform,
	  it should be set y by defconfig.
	  the kernel checkpatch request at least 4 lines to
	  describe this symbol i need say something to pass the check.

config BITMAIN_PINCTRL_BM1880
	bool "This enable pinctrl for bm1880 platform"
	select BITMAIN_PINCTRL_CORE
	help
	  This enable pinctrl driver for bitmain bm1880 platform,
	  it should be set y by defconfig.
	  the kernel checkpatch request at least 4 lines to
	  describe this symbol i need say something to pass the check.

endif
```

## linux-linaro-stable/drivers/soc/bitmain/Kconfig
```kconfig
#
# Bitmain SoC drivers
#
menu "Bitmain SoC drivers"

config BITMAIN_NPU
	bool "Bitmain SoC NPU Controller driver"
	depends on ARCH_BITMAIN && ARCH_BM1880
	help
	  Enables driver for the npu controller on Bitmain SoC.

config BITMAIN_BMDNN
	bool "Bitmain SoC BMDNN driver"
	depends on ARCH_BITMAIN
	help
	  Simulate PCIe driver's interface on SoC.


config BM_SUBSYS_INT_EN
	bool "bm1684/bm1880 subsys interrupt i2s/uart/dma enable"
	default n
	depends on ARCH_BITMAIN
	help
	  enable bm1684/bm1880 i2s/uart/dma interrupts.


config I2C_SUPPRESS_SCL_100KHZ
	bool "DW I2C master mode driver option"
	default n
	depends on I2C_DESIGNWARE_PLATFORM
	help
	  suppress DW I2C master mode 100KHz timing.

endmenu
```

## linux-linaro-stable/drivers/vpp/Kconfig
```kconfig
menu "vpp driver "
comment "vpp driver "

config VPP_ENB
	tristate "vpp kernel driver"
	help
	this is vpp kernel driver

config VPP_1880
	tristate "vpp support 1880"
	help
	this is vpp support 1880

config VPP_1684
	tristate "vpp support 1684"
	help
	this is vpp support 1684

endmenu
```

## linux-linaro-stable/sound/soc/bitmain/Kconfig
```kconfig
#
# Bitmain Audio Sound SoC drivers
#

config SND_SOC_BITMAIN_ADAU1372
	tristate "Support for the BITMAIN-ADAU1373 board"
	depends on SND
	help
	  Say Y if you want to add support for the Analog
	  Devices ADAU1372 board connected to the Bitmain boards
	  like the BM1880.
	  If not, please don't select it




config SND_BITMAIN_I2S
	tristate "Synopsys I2S Device Driver"
	depends on CLKDEV_LOOKUP
	select SND_SOC_GENERIC_DMAENGINE_PCM
	help
	 Say Y or M if you want to add support for I2S driver for
	 bitmain I2S device. The device supports upto maximum of
	 2 channels each for play and record.
	 Say N, if not support

config SND_BITMAIN_PCM
	tristate "PCM PIO extension for I2S driver"
	depends on SND_BITMAIN_I2S
	help
	 Say Y, M or N if you want to add a custom ALSA extension that registers
	 a PCM and uses PIO to transfer data.

	 This functionality is specially suited for I2S devices that don't have
	 DMA support.
```
