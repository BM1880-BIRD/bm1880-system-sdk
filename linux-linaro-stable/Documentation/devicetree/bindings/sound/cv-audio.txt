## linux-linaro-stable/Documentation/devicetree/bindings/sound/cv-audio.txt
```
* BM1880 V2 I2S/PCM/TDM module

Required properties:
- compatible: "cv,i2s_tdm_subsys"
- compatible: "cv,audio"
- compatible: "cv,cv-i2s"
- cv,model: The module name of bitmain platform.
- cv,audio-codec: The codec used by BM1880 platform.
- cv,i2s-controller: the i2s interface used by BM1880.
- cv,codec-clock-rate: The clock rate.

Example:

	i2s_subsys {
		compatible = "cv,i2s_tdm_subsys";
		regbase = <0x04108000>;
		sclk_fs_in_sel = <0x7654>;
		sdi_in_sel = <0x7654>;
		sdo_out_sel = <0x7654>;
		multi_sync = <0x0000>;
		bclk_oen_sel = <0x1>;
	};


	i2s0: i2s@04100000 {
		compatible = "cv,cv-i2s";
		reg = <0x0 0x04100000 0x0 0x2000>;
		interrupts = <GIC_SPI 3 IRQ_TYPE_LEVEL_HIGH>;
		clocks = <&i2s_mclk 0>;
		clock-names = "i2sclk";
		dev-id = <0>;
		#sound-dai-cells = <0>;
		dmas = <&dmac 0 1 1 /* read channel */
			&dmac 1 1 1>; /* write channel */
		dma-names = "rx", "tx";
	};

	sound {

		compatible = "cv,audio";

		cv,model = "CV1880";

		cv,audio-codec = <&adau1372_1>;

		cv,i2s-controller = <&i2s0>;

		cv,codec-clock-rate = <12288000>;
	}
```

## linux-linaro-stable/Documentation/devicetree/bindings/spi/spi-bitmain.txt
```
Bitmain Synchronous Serial Interface.

Required properties:
- compatible : "snps,dw-apb-ssi"
- reg : The register base for the controller.
- interrupts : One interrupt, used by the controller.
- #address-cells : <1>, as required by generic SPI binding.
- #size-cells : <0>, also as required by generic SPI binding.

Optional properties:
- cs-gpios : Specifies the gpio pis to be used for chipselects.
- num-cs : The number of chipselects. If omitted, this will default to 4.

Child nodes as per the generic SPI binding.

Required properties:
- compatible : "rohm,dh2228fv"
- reg : The register base for the controller.
- spi-max-frequency: The maximum frequency of spi

Example:

	spi0:spi0@50030000 {
		compatible = "snps,dw-apb-ssi";
		reg = <0x0 0x50030000 0x0 0x1000>;
		interrupts = <GIC_SPI 65 IRQ_TYPE_LEVEL_HIGH>;
		clocks = <&pclk>;
		clock-frequency = <25000000>;
		#address-cells = <1>;
		#size-cells = <0>;
		num-cs = <1>;
		switch-gpios = <&port0a 7 0>;

		spidev: spidev@0 {
			compatible = "rohm,dh2228fv";
			spi-max-frequency = <25000000>;
			reg = <0>;
		};
	};


Add pinmux to activate spi0
Example:

	spi0-mux{
		compatible = "bitmain,spi0-mux";
		pinctrl-names= "acquire", "release";
		pinctrl-0= <&spi0_acquire>;
		pinctrl-1= <&spi0_release>;
	};
```

## linux-linaro-stable/Documentation/devicetree/bindings/staging/ion/bitmain-ion.txt
```
Bitmain SoC ION

Required properties:
- compatible : "ion-region"
- compatible : "vpp-region"
- compatible : "npu-region"
- compatible : "vpu-region"
- compatible : "jpu-region"
- compatible : "bitmain,bitmain-ion"
Heaps:
- compatible : "bitmain,sys_user"
- compatible : "bitmain,sys_contig"
- compatible : "bitmain,carveout"
- compatible : "bitmain,carveout_vpp"
- compatible : "bitmain,carveout_npu"
- compatible : "bitmain,dma"
- compatible : "bitmain,cma_vpp"
```

## linux-linaro-stable/Documentation/devicetree/bindings/thermal/bitmain,bm1880-cooling.txt
```
BM1880 cooling device

Required properties:
- compatible: "bitmain,bm1880-cooling"
- #cooling-cells: Must be 2

Example:
	bm1880_cooling: bm1880_cooling {
		compatible = "bitmain,bm1880-cooling";
		#cooling-cells = <2>;
	};
```

## linux-linaro-stable/Documentation/devicetree/bindings/top/bm-top.txt
```
Bitmain top controller

Required properties:
- compatible: should contain "bitmain,top-misc"
- reg: physical base address and length of the controller's registers
```

## linux-linaro-stable/Documentation/devicetree/bindings/usb/bitmain-usb.txt
```
compatible = "bitmain,usb-otg"
compatible = "bitmain,xhci-platform"
compatible = "bitmain,usb-dev"

Example HSUSB OTG controller device node:

	otg0:bm-usb-otg@50080000 {
                compatible = "bitmain,usb-otg";
                reg = <0x0 0x50080000 0x0 0x10000>;
                interrupts = <GIC_SPI 82 IRQ_TYPE_EDGE_RISING>;
                clock-frequency = <25000000>;
        };
        host0:bm-usb-host@50090000 {
                compatible = "bitmain,xhci-platform";
                reg = <0x0 0x50090000 0x0 0x10000>,
                        <0x0 0x50010000 0x0 0x1000>;
                interrupts = <GIC_SPI 85 IRQ_TYPE_EDGE_RISING>;
                otg-controller = <&otg0>;
                clock-frequency = <25000000>;
        };
        usb0:bm-usb-dev@500A0000 {
                compatible = "bitmain,usb-dev";
                reg = <0x0 0x500A0000 0x0 0x1000>;
                interrupts = <GIC_SPI 83 IRQ_TYPE_EDGE_RISING>;
                otg-controller = <&otg0>;
                clock-frequency = <25000000>;
        };
```

## linux-linaro-stable/arch/arm64/Kconfig.platforms
```kconfig
menu "Platform selection"

config ARCH_SUNXI
	bool "Allwinner sunxi 64-bit SoC Family"
	select GENERIC_IRQ_CHIP
	select PINCTRL
	select PINCTRL_SUN50I_A64
	help
	  This enables support for Allwinner sunxi based SoCs like the A64.

config ARCH_ALPINE
	bool "Annapurna Labs Alpine platform"
	select ALPINE_MSI if PCI
	help
	  This enables support for the Annapurna Labs Alpine
	  Soc family.

config ARCH_BCM2835
	bool "Broadcom BCM2835 family"
	select CLKSRC_OF
	select GPIOLIB
	select PINCTRL
	select PINCTRL_BCM2835
	select ARM_AMBA
	select ARM_TIMER_SP804
	select HAVE_ARM_ARCH_TIMER
	help
	  This enables support for the Broadcom BCM2837 SoC.
	  This SoC is used in the Raspberry Pi 3 device.

config ARCH_BCM_IPROC
	bool "Broadcom iProc SoC Family"
	select COMMON_CLK_IPROC
	select GPIOLIB
	select PINCTRL
	help
	  This enables support for Broadcom iProc based SoCs

config ARCH_BERLIN
	bool "Marvell Berlin SoC Family"
	select DW_APB_ICTL
	select GPIOLIB
	select PINCTRL
	help
	  This enables support for Marvell Berlin SoC Family

config ARCH_BRCMSTB
	bool "Broadcom Set-Top-Box SoCs"
	select BRCMSTB_L2_IRQ
	select GENERIC_IRQ_CHIP
	help
	  This enables support for Broadcom's ARMv8 Set Top Box SoCs

config ARCH_BITMAIN
	bool "Bitmain SoC Family"
	select ION_BITMAIN

	help
	  This enables support for Bitmain SoC family

if ARCH_BITMAIN
choice
	prompt "Select the chip of SoC"
	default ARCH_BM1682
	help
	  Select the chip for SoC

config ARCH_BM1682
	bool "Bitmain BM1682 SoC"
	help
	  This enables support for Bitmain's BM1682

config ARCH_BM1684
	bool "Bitmain BM1684 SoC"
	select PINCTRL
	help
	  This enables support for Bitmain's BM1684

config ARCH_BM1880
	bool "Bitmain BM1880 SoC"
	select PINCTRL
	select PINCTRL_BM
	select PINMUX
	select PINCONF
	select GENERIC_PINCONF
	help
	  This enables support for Bitmain's BM1880
endchoice

if ARCH_BM1682
choice
	prompt "Select the platform of SoC"
	default ARCH_BM1682
	help
	  Select the platform of SoC

config ARCH_BM1682_QEMU
       bool "Bitmain BM1682 SoC - QEMU"
       help
         This enables support for Bitmain's BM1682 SoC on QEMU platform

config ARCH_BM1682_PALLADIUM
       bool "Bitmain BM1682 SoC - Palladium"
       help
         This enables support for Bitmain's BM1682 SoC on Palladium platform

config ARCH_BM1682_ASIC
       bool "Bitmain BM1682 SoC- ASIC"
       help
         This enables support for Bitmain's BM1682 SoC
endchoice
endif # end of ARCH_BM1682

if ARCH_BM1684
choice
	prompt "Select the platform of SoC"
	default ARCH_BM1684
	help
	  Select the platform of SoC

config ARCH_BM1684_PALLADIUM
       bool "Bitmain BM1684 SoC - Palladium"
       help
         This enables support for Bitmain's BM1684 SoC on Palladium platform

config ARCH_BM1684_FPGA
       bool "Bitmain BM1684 SoC- FPGA"
       help
         This enables support for Bitmain's BM1684 SoC FPGA

config ARCH_BM1684_ASIC
       bool "Bitmain BM1684 SoC- EVB"
       help
         This enables support for Bitmain's BM1684 SoC EVB
endchoice
endif # end of ARCH_BM1684

if ARCH_BM1880
choice
	prompt "Select the platform of SoC"
	default ARCH_BM1880
	help
	  Select the platform of SoC

config ARCH_BM1880_QEMU
       bool "Bitmain BM1880 SoC - QEMU"
       help
         This enables support for Bitmain's BM1880 SoC on QEMU platform

config ARCH_BM1880_PALLADIUM
       bool "Bitmain BM1880 SoC - Palladium"
       help
         This enables support for Bitmain's BM1880 SoC on Palladium platform

config ARCH_BM1880_FPGA
       bool "Bitmain BM1880 SoC - FPGA"
       help
         This enables support for Bitmain's BM1880 SoC on FPGA platform

config ARCH_BM1880_ASIC
       bool "Bitmain BM1880 SoC- ASIC"
       help
         This enables support for Bitmain's BM1880 SoC AISC

config ARCH_BM1880_ASIC_MINER
       bool "Bitmain BM1880 SoC- ASIC MINER"
       help
         This enables support for Bitmain's BM1880 SoC MINER(AISC)

config ARCH_BM1880_FPGA_MINER
       bool "Bitmain BM1880 SoC- FPGA MINER"
       help
         This enables support for Bitmain's BM1880 SoC MINER(FPGA)

endchoice

if ARCH_BM1880_ASIC
config BM1880_PRODUCT_EDB
       bool "Bitmain BM1880 Product - EDB"
       help
         This enables support for Bitmain's BM1880 SoC on EDB platform
endif # end of ARCH_BM1880_ASIC

endif # end of ARCH_BM1880
endif # end of ARCH_BITMAIN

config ARCH_EXYNOS
	bool "ARMv8 based Samsung Exynos SoC family"
	select COMMON_CLK_SAMSUNG
	select HAVE_S3C2410_WATCHDOG if WATCHDOG
	select HAVE_S3C_RTC if RTC_CLASS
	select PINCTRL
	select PINCTRL_EXYNOS
	select SOC_SAMSUNG
	help
	  This enables support for ARMv8 based Samsung Exynos SoC family.

config ARCH_LAYERSCAPE
	bool "ARMv8 based Freescale Layerscape SoC family"
	select EDAC_SUPPORT
	help
	  This enables support for the Freescale Layerscape SoC family.

config ARCH_LG1K
	bool "LG Electronics LG1K SoC Family"
	help
	  This enables support for LG Electronics LG1K SoC Family

config ARCH_HISI
	bool "Hisilicon SoC Family"
	select ARM_TIMER_SP804
	select HISILICON_IRQ_MBIGEN if PCI
	select PINCTRL
	help
	  This enables support for Hisilicon ARMv8 SoC family

config ARCH_MEDIATEK
	bool "Mediatek MT65xx & MT81xx ARMv8 SoC"
	select ARM_GIC
	select PINCTRL
	select MTK_TIMER
	help
	  Support for Mediatek MT65xx & MT81xx ARMv8 SoCs

config ARCH_MESON
	bool "Amlogic Platforms"
	select PINCTRL
	select PINCTRL_MESON
	select COMMON_CLK_AMLOGIC
	select COMMON_CLK_GXBB
	help
	  This enables support for the Amlogic S905 SoCs.

config ARCH_MVEBU
	bool "Marvell EBU SoC Family"
	select ARMADA_AP806_SYSCON
	select ARMADA_CP110_SYSCON
	select ARMADA_37XX_CLK
	select MVEBU_ODMI
	select MVEBU_PIC
	help
	  This enables support for Marvell EBU familly, including:
	   - Armada 3700 SoC Family
	   - Armada 7K SoC Family
	   - Armada 8K SoC Family

config ARCH_QCOM
	bool "Qualcomm Platforms"
	select PINCTRL
	help
	  This enables support for the ARMv8 based Qualcomm chipsets.

config ARCH_ROCKCHIP
	bool "Rockchip Platforms"
	select ARCH_HAS_RESET_CONTROLLER
	select GPIOLIB
	select PINCTRL
	select PINCTRL_ROCKCHIP
	select ROCKCHIP_TIMER
	help
	  This enables support for the ARMv8 based Rockchip chipsets,
	  like the RK3368.

config ARCH_SEATTLE
	bool "AMD Seattle SoC Family"
	help
	  This enables support for AMD Seattle SOC Family

config ARCH_SHMOBILE
	bool

config ARCH_RENESAS
	bool "Renesas SoC Platforms"
	select ARCH_SHMOBILE
	select PINCTRL
	select PM
	select PM_GENERIC_DOMAINS
	select RENESAS_IRQC
	help
	  This enables support for the ARMv8 based Renesas SoCs.

config ARCH_R8A7795
	bool "Renesas R-Car H3 SoC Platform"
	depends on ARCH_RENESAS
	help
	  This enables support for the Renesas R-Car H3 SoC.

config ARCH_R8A7796
	bool "Renesas R-Car M3-W SoC Platform"
	depends on ARCH_RENESAS
	help
	  This enables support for the Renesas R-Car M3-W SoC.

config ARCH_STRATIX10
	bool "Altera's Stratix 10 SoCFPGA Family"
	help
	  This enables support for Altera's Stratix 10 SoCFPGA Family.

config ARCH_TEGRA
	bool "NVIDIA Tegra SoC Family"
	select ARCH_HAS_RESET_CONTROLLER
	select CLKDEV_LOOKUP
	select CLKSRC_MMIO
	select CLKSRC_OF
	select GENERIC_CLOCKEVENTS
	select GPIOLIB
	select PINCTRL
	select PM
	select PM_GENERIC_DOMAINS
	select RESET_CONTROLLER
	help
	  This enables support for the NVIDIA Tegra SoC family.

config ARCH_SPRD
	bool "Spreadtrum SoC platform"
	help
	  Support for Spreadtrum ARM based SoCs

config ARCH_THUNDER
	bool "Cavium Inc. Thunder SoC Family"
	help
	  This enables support for Cavium's Thunder Family of SoCs.

config ARCH_UNIPHIER
	bool "Socionext UniPhier SoC Family"
	select ARCH_HAS_RESET_CONTROLLER
	select PINCTRL
	help
	  This enables support for Socionext UniPhier SoC family.

config ARCH_VEXPRESS
	bool "ARMv8 software model (Versatile Express)"
	select COMMON_CLK_VERSATILE
	select GPIOLIB
	select PM
	select PM_GENERIC_DOMAINS
	select POWER_RESET_VEXPRESS
	select VEXPRESS_CONFIG
	help
	  This enables support for the ARMv8 software model (Versatile
	  Express).

config ARCH_VULCAN
	bool "Broadcom Vulcan SOC Family"
	select GPIOLIB
	help
	  This enables support for Broadcom Vulcan SoC Family

config ARCH_XGENE
	bool "AppliedMicro X-Gene SOC Family"
	help
	  This enables support for AppliedMicro X-Gene SOC Family

config ARCH_ZX
	bool "ZTE ZX SoC Family"
	help
	  This enables support for ZTE ZX SoC Family

config ARCH_ZYNQMP
	bool "Xilinx ZynqMP Family"
	help
	  This enables support for Xilinx ZynqMP Family

endmenu
```
