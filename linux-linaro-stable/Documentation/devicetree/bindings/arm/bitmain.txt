## linux-linaro-stable/Documentation/devicetree/bindings/arm/bitmain.txt
```
Bitmain Platforms Device Tree Bindings

Boards with a Bitmain BM168x/BM188x SoC shall have the
following property:

Required properties:
- compatible : ""
        this is a legacy name from qemu platform.

Required root node property:

compatible: Must contain one of
   "linux,dummy-virt"
   "bitmain,bm1682"
   "bitmain,bm1684"
   "bitmian,bm1880"


Supported boards:

- Evaluation board for BM1682:
    Required root node properties:
      - compatible = "bitmain,bm1682-evb", "bitmain,bm1682";
- Evaluation board for BM1684:
    Required root node properties:
      - compatible = "bitmain,bm1684-evb", "bitmain,bm1684";
- Evaluation board for BM1880:
    Required root node properties:
      - compatible = "bitmain,bm1880-evb", "bitmain,bm1880";
```

## linux-linaro-stable/Documentation/devicetree/bindings/cpufreq/bm_cpufreq.txt
```
Bitmain cpufreq

Required properties:
- compatible: "bitmain,bm-cpufreq"
- bitmain,cpufreq-table: cpu frequency table (kHz), now only one freq in 1682/1684/1880
     example for 1682:
          bitmain,cpufreq-table =  <  1800000 >;
```

## linux-linaro-stable/Documentation/devicetree/bindings/crypto/bitmain-crypto-engine.txt
```
Bitmain Cryptographic Engines

Required properties:
- compatible: should be one of the following string
	      "bitmain,crypto-engine"
	      "bitmain,spacc"
	      "bitmain,ce"

- reg: base physical address of the engine and length of memory mapped region.
- interrupts: interrupt number

Examples:

	bce@58004000 {
		compatible = "bitmain,crypto-engine";
		reg = <0x00000000 0x58004000 0x00000000 0x00001000>;
		interrupts = <GIC_SPI 18 IRQ_TYPE_LEVEL_HIGH>;
		bus-width = <4>;
	};
```

## linux-linaro-stable/Documentation/devicetree/bindings/efuse/bm-efuse.txt
```
Bitmain efuse controller

Required properties:
- compatible: should be "bitmain,bm-efuse"
- reg: physical base address and length of the controller's registers
- num_address_bits:num_address_bits
```

## linux-linaro-stable/Documentation/devicetree/bindings/fan-speed/fan-speed-bm.txt
```
Bitmain Fan Speed controller

Required properties:
- compatible: should be "bitmain,bm-fan-speed"
- reg: physical base address and length of the controller's registers
```

## linux-linaro-stable/Documentation/devicetree/bindings/hwlock/bitmain,hwspinlock.txt
```
BITMAIN Hardware spinlock device Binding
-----------------------------------------------

Required properties :
- compatible : shall contain only one of the following:
	"sirf,hwspinlock"

- reg : the register address of hwspinlock

- #hwlock-cells : hwlock users only use the hwlock id to represent a specific
	hwlock, so the number of cells should be <1> here.

Please look at the generic hwlock binding for usage information for consumers,
"Documentation/devicetree/bindings/hwlock/hwlock.txt"

Example of hwlock provider:
	hwspinlock: spinlock {
		compatible = "bitmain,hwspinlock";
		spinlock_numbers = <4>;
	};

Example of hwlock users:
	node {
		...
		hwlocks = <&hwlock 2>;
		...
	};
```

## linux-linaro-stable/Documentation/devicetree/bindings/media/bitmain-vcodec.txt
```
Bitmain Video Decoder (bitmain-vdec)

Bitmain Video Decoder is the HW video acceleration in Bitmain SoCs which
supports high resolution decoding functionalities.

Required properties:
- compatible : "bitmain,bitmain-vdec" for decoder
- reg : Physical base address of the video codec registers and length of
  memory mapped region.
- interrupts : interrupt number to the cpu.

Example:
vpu: vpu@50440000 {
    compatible = "bitmain,bitmain-vdec";
    reg = <0 0x50440000 0 0x10000>,    /*vpu register*/
    interrupts = <GIC_SPI 80 IRQ_TYPE_LEVEL_HIGH>,
		<GIC_SPI 81 IRQ_TYPE_LEVEL_HIGH>,
		<GIC_SPI 82 IRQ_TYPE_LEVEL_HIGH>;
  };
```

## linux-linaro-stable/Documentation/devicetree/bindings/media/i2c/imx290.txt
```
* IM290 Camera

The Sony IMX290 is a 6.46mm CMO active pixel type solid-state image sensor
with a square pixel array and 2.13M effective pixels. It is programmable
through a i2C. The IMX290 sensor supports 1080P and 720P. It also can
support raw RGB 10bit/12bit output formats.

Required Properties:
- compatible: Must be "sony,imx290"
- reg: I2C slave address
- link-frequencies: target pixel clock frequency.

For further reading on port node refer to
Documentation/devicetree/bindings/media/video-interfaces.txt.

Example:

	i2c3: i2c@04030000 {
		...
		...
		camera0: imx290@1A {
			compatible = "sony,imx290";
			reg = <0x1A>;
			//clocks = <&ext_cam_clk>;
			status = "okay";
		};
		...
	};
```

## linux-linaro-stable/Documentation/devicetree/bindings/mmc/sdhci-bm.txt
```
* Bitmain SDHCI controller (sdhci-bm)

This file documents differences between the core properties in mmc.txt
and the properties used by the sdhci-msm driver.

Required properties:
- compatible: Should be one of
        "bitmain,bm-emmc"
        "bitmain,bm-sd"
        "bitmain,bm-pldm-emmc"
        "bitmain,bm-pldm-sdcard"
        "bitmain,bm1880-emmc"
        "bitmain,bm1880-sd"
- reg: Base address and length of the register in the following order:
	- Host controller register map (required)
	- SD Core register map (required)
- interrupts: Should contain an interrupt-specifiers for the interrupts:
	- Host controller interrupt (required)
- pinctrl-names: Should contain only one value - "default".
- pinctrl-0: Should specify pin control groups used for this controller.
- clocks: A list of phandle + clock-specifier pairs for the clocks listed in clock-names.
- clock-names: Should contain the following:
	"core"	- SDC MMC clock (MCLK) (required)

Example:

	emmc:bm-emmc@4fffe000 {
		compatible = "bitmain,bm-emmc";
		reg = <0x0 0x4fffe000 0x0 0x1000>;
		reg-names = "core_mem";
		interrupts = <GIC_SPI 51 IRQ_TYPE_LEVEL_HIGH>;//83-32=51 emmc intr ,84 emmc_wakeup_intr,85 sdio_intr,86 sdio_wakeup_intr
		bus-width = <4>;
		non-removable;
		no-sdio;
		no-sd;
	};

	sd:bm-sd@4ffff000 {
		compatible = "bitmain,bm-sd";
		reg = <0x0 0x4ffff000 0x0 0x1000>;
		reg-names = "core_mem";
		interrupts = <GIC_SPI 53 IRQ_TYPE_LEVEL_HIGH>;//83-32=51 emmc intr ,84 emmc_wakeup_intr,85 sdio_intr,86 sdio_wakeup_intr
		bus-width = <4>;
		no-sdio;
		no-mmc;
		resets = <&rst RST_SDIO>;
		reset-names = "sdio";
	};
```

## linux-linaro-stable/Documentation/devicetree/bindings/net/wireless/bitmain,wireless.txt
```
Bitmain wireless USB devices

This node provides properties for controlling the Bitmain wireless device.
It controls GPIO which is used for wifi chip enable

Required properties:

 - compatible : Should be "bitmain,wifi-mux".

Optional properties:
 - n/a

Example:

	wifi-mux{
		compatible = "bitmain,wifi-mux";
		source_mux = <0x500104fc>;
		mux_offset = <0x04>;
		mux_value  = <0x1>;
		pinctrl-names= "acquire", "release";
		pinctrl-0= <&gpio13_acquire>;
		pinctrl-1= <&gpio13_release>;
	};
```

## linux-linaro-stable/Documentation/devicetree/bindings/pinctrl/bm,pinctrl.txt
```
compatible = "bitmain,pinctrl-bm1880"
compatible = "bitmain,pinctrl-bm1684"
compatible = "bitmain,nand-mux"
compatible = "bitmain,spi-mux"
compatible = "bitmain,emmc-mux"
compatible = "bitmain,uart1-mux"
compatible = "bitmain,uart2-mux"
compatible = "bitmain,uart3-mux"
compatible = "bitmain,uart4-mux"
compatible = "bitmain,uart5-mux"
compatible = "bitmain,uart6-mux"
compatible = "bitmain,uart7-mux"
compatible = "bitmain,uart8-mux"
compatible = "bitmain,uart9-mux"
compatible = "bitmain,uart10-mux"
compatible = "bitmain,uart11-mux"
compatible = "bitmain,pwm-mux"
compatible = "bitmain,fan-mux"
compatible = "bitmain,i2c-mux"
compatible = "bitmain,eth-mux"
compatible = "bitmain,i2s-mux"
compatible = "bitmain,spif-mux"
compatible = "bitmain,gpio-mux"
```

## linux-linaro-stable/Documentation/devicetree/bindings/pwm/pwm-bm.txt
```
Bitmain PWM controller

Required properties:
- compatible: should be "bitmain,bm-pwm"
- reg: physical base address and length of the controller's registers
- clocks: lable to the input clock
- #pwm-cells: should be 1. See pwm.txt in this directory for a description of
```

## linux-linaro-stable/Documentation/devicetree/bindings/reset/bitmain-reset.txt
```
Bitmian reset controller

Required properties:
- compatible: "bitmain,reset", "bitmain,clk-reset"
- #reset-cells: Must be 1
```

## linux-linaro-stable/Documentation/devicetree/bindings/soc/bitmain/bm1682mcu.txt
```
Bitmain bm1682 MCU driver, just for soc aisc platform.
Required properties:
- compatible: "bitmain,bm1682-mcu"
- reg: should be the mcu slave address in i2c bus.
```

## linux-linaro-stable/Documentation/devicetree/bindings/soc/bitmain/bmdnn.txt
```
Bitmain NPU driver, PCIe host style, just for aicplatform demo.

Required properties:
- compatible: "bitmain,bmdnn"
- reg: to simulate the 3 PCIe bars, here should also provide 3 register regions,
       same as the PCIe bar mappings.
- interrupts: CDMA interrupt number
```

## linux-linaro-stable/Documentation/devicetree/bindings/soc/bitmain/bmtpu.txt
```
Bitmain TPU driver, PCIe host style, just for aicplatform demo.

Required properties:
- compatible: "bitmain,tpu-1682"
- compatible: "bitmain,tpu-1684"
- reg: to simulate the 3 PCIe bars, here should also provide 3 register regions,
       same as the PCIe bar mappings.
- interrupts: CDMA interrupt number
```

## linux-linaro-stable/Documentation/devicetree/bindings/soc/bitmain/i2c_slave.txt
```
Bitmain bm1682 i2c slave mode driver, just for soc aisc platform.
Required properties:
- compatible: "snps,dw-i2c-slave"
- reg: should be the i2c slave address in slave mode. Must set bit30 as slave
  mask flag.
```

## linux-linaro-stable/Documentation/devicetree/bindings/soc/bitmain/jpu.txt
```
Bitmain jpu driver

Required properties:
- compatible: "bitmain,jpeg"
- reg: jpu register regions
- interrupts: jpu interrupt number
```

## linux-linaro-stable/Documentation/devicetree/bindings/soc/bitmain/npu.txt
```
Bitmain NPU driver

Required properties:
- compatible: "bitmain,npu"
- reg: GDMA and broadcast engine's register regions
- interrupts: GDMA interrupt number
- resets: reset handles for NPS and GDMA
- reset-names: should be "nps" and "gdma"
```

## linux-linaro-stable/Documentation/devicetree/bindings/soc/bitmain/subsys_int_en.txt
```
Bitmain bm1684/bm1880 subsys_int_en driver, just for soc aisc platform.
Required properties:
- compatible: "bitmain,subsys-int-en"
```

## linux-linaro-stable/Documentation/devicetree/bindings/soc/bitmain/vip.txt
```
Bitmain vip driver

This document describes the binding for the Bitmain vip.

Required properties:
- compatible: "bitmain,vip"
- reg: vip register regions
- interrupts: vip interrupt number
```

## linux-linaro-stable/Documentation/devicetree/bindings/soc/bitmain/vpu.txt
```
Bitmain vpu driver

Required properties:
- compatible: "bitmain,vpu"
- reg: vpu register regions
- interrupts: vpu interrupt number
```

## linux-linaro-stable/Documentation/devicetree/bindings/sound/adi,adau1372.txt
```
Analog Devices ADAU1372

Required properties:

 - compatible:		Should contain one of the following:
			"adi,adau1372"

 - reg:			The i2c address. Value depends on the state of ADDR0
			and ADDR1, as wired in hardware.

Optional properties:
 - clock-names:		If provided must be "mclk".
 - clocks:		phandle + clock-specifiers for the clock that provides
			the audio master clock for the device.

Examples:
#include <dt-bindings/sound/adau1372.h>

	i2c_bus {
		adau1372@3C {
			compatible = "adi,adau1372";
			reg = <0x3C>;

			clock-names = "mclk";
			clocks = <&audio_clock>;
		};
	};
```

## linux-linaro-stable/Documentation/devicetree/bindings/sound/bitmain-audio.txt
```
* BITMAIN I2S/PCM module

Required properties:
- compatible: "bitmain,audio"
- bitmain,model: The module name of bitmain platform.
- bitmain,audio-codec: The codec used by BM1880 platform.
- bitmain,i2s-controller: the i2s interface used by BM1880.
- bitmain,codec-clock-rate: The clock rate.

Example:

	sound {

		compatible = "bitmain,audio";

		bitmain,model = "BM1880";

		bitmain,audio-codec = <&adau1372>;

		bitmain,i2s-controller = <&i2s0>;

		bitmain,codec-clock-rate = <12288000>;
	}
```
